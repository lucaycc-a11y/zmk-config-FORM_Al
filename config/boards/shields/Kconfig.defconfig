## config/boards/shields/Kconfig.defconfig
```kconfig
if SHIELD_FORM_Al_LEFT

config ZMK_KEYBOARD_NAME
    default "FORM_Al"

config ZMK_SPLIT_ROLE_CENTRAL
    default y

endif

if SHIELD_FORM_Al_LEFT || SHIELD_FORM_Al_RIGHT

config ZMK_SPLIT
    default y

endif
```

## config/boards/shields/Kconfig.shield
```kconfig
config SHIELD_FORM_Al_LEFT
    def_bool $(shields_list_contains,FORM_Al_left)

config SHIELD_FORM_Al_RIGHT
    def_bool $(shields_list_contains,FORM_Al_right)
```
